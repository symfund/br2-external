## Config.in
```kconfig
menu "TensorFlow Runtime Libraries"

source "$BR2_EXTERNAL_EXTPACK_PATH/package/tensorflow-lite/Config.in"
source "$BR2_EXTERNAL_EXTPACK_PATH/package/tflite-evaluator/Config.in"
source "$BR2_EXTERNAL_EXTPACK_PATH/package/farmhash/Config.in"

endmenu
```

## package/adb/Config.in
```kconfig
menuconfig BR2_PACKAGE_ADB
        bool "Android Debug Bridge (adbd)"
        select BR2_PACKAGE_ANDROID_TOOLS
	select BR2_PACKAGE_MONIT
        help
          This package for ADBD.

if BR2_PACKAGE_ADB

config BR2_PACKAGE_ADB_SERIAL
        bool "serial"

config BR2_PACKAGE_ADB_NETWORK
	bool "ethernet"

config BR2_PACKAGE_ADB_STORAGE
	bool "storage"

endif
```

## package/farmhash/Config.in
```kconfig
config BR2_PACKAGE_FARMHASH
	bool "farmhash"
	depends on BR2_INSTALL_LIBSTDCPP
	help
	  FarmHash is a family of very fast, non-cryptographic
	  hash functions for strings and other data.

	  https://github.com

comment "farmhash needs a toolchain w/ C++"
	depends on !BR2_INSTALL_LIBSTDCPP
```

## package/tflite-evaluator/Config.in
```kconfig
menu "TensorFlow Lite Tools & Demos"

config BR2_PACKAGE_TFLITE_EVALUATOR
	bool "tflite-evaluator"
	depends on BR2_PACKAGE_TENSORFLOW_LITE

endmenu
```
