## package/tensorflow-lite/Config.in
```kconfig
comment "tensorflow-lite needs a toolchain w/ C++, threads, gcc >= 9"
        depends on !BR2_INSTALL_LIBSTDCPP || !BR2_TOOLCHAIN_HAS_THREADS || !BR2_TOOLCHAIN_GCC_AT_LEAST_9

config BR2_PACKAGE_TENSORFLOW_LITE
	bool "tensorflow-lite"
	depends on BR2_INSTALL_LIBSTDCPP
	depends on BR2_TOOLCHAIN_HAS_THREADS
	depends on BR2_TOOLCHAIN_GCC_AT_LEAST_9 # TFLite 2.21 requires modern GCC
	select BR2_PACKAGE_FLATBUFFERS
	select BR2_PACKAGE_EIGEN
	select BR2_PACKAGE_LIBABSEIL_CPP
	select BR2_PACKAGE_FARMHASH
	select BR2_PACKAGE_PROTOBUF
	select BR2_PACKAGE_FXDIV
	help
	  TensorFlow Lite is a set of tools to help developers run 
	  TensorFlow models on mobile, embedded, and IoT devices.

	  https://tensorflow.org

if BR2_PACKAGE_TENSORFLOW_LITE

menu "TensorFlow Lite Tools & Demos"

config BR2_PACKAGE_TFLITE_EVALUATOR
        bool "TFLite Evaluator"
        depends on BR2_PACKAGE_TENSORFLOW_LITE

config BR2_PACKAGE_IMAGE_CLASSIFIER
        bool "Image Classifier"
        depends on BR2_PACKAGE_TENSORFLOW_LITE

endmenu

endif
```
